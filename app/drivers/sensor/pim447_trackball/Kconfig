## app/drivers/sensor/pim447_trackball/Kconfig
```kconfig
# Copyright (c) 2021 Cedric VINCENT
# SPDX-License-Identifier: Apache-2.0

config ZMK_PIM447_TRACKBALL
	bool "ZMK PIM447 trackball"
	help
	  Enable I2C-based driver for Pimorono PIM447 trackball.
```
